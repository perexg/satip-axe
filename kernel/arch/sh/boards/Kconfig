## kernel/drivers/stm/Kconfig
```kconfig
#
# STM specific device configuration
#

config STM_DRIVERS
	boolean
	default y if CPU_SUBTYPE_ST40
	default n

menu "STM specific devices"
        depends on STM_DRIVERS

config STM_PCI_EMISS
	bool "STMicroelectronics PCI controller"
	depends on PCI && (CPU_SUBTYPE_FLI7510 || CPU_SUBTYPE_STX5206 || \
			   CPU_SUBTYPE_STX7105 || CPU_SUBTYPE_STX7108 || \
			   CPU_SUBTYPE_STX7111)
	def_bool n
	select GENERIC_IOMAP
	---help---
	  This option adds support for the PCI controller found on some
	  STMicroelectronics SOCs.

# PCIe controller from synopsys, wrapped for HVD parts
config STM_PCIE
	bool "STMicroelectronics PCI express controller"
	depends on PCI && (CPU_SUBTYPE_STX7108 || CPU_SUBTYPE_FLI7510)
	def_bool n
	select ARCH_SUPPORTS_MSI
	---help---
	  This option adds support for the PCI express controller found on some
	  STMicroelectronics SOCs.

config STM_MIPHY
	def_bool y
	depends on (SATA_STM || STM_PCIE)

config STM_MIPHY_TAP
	bool
	depends on STM_MIPHY
	default y if CPU_SUBTYPE_STX7105
	default y if CPU_SUBTYPE_STX7108
	default y if CPU_SUBTYPE_STX7141
	default y if CPU_SUBTYPE_STX7200
	default n

config STM_MIPHY_PCIE_MP
	bool
	depends on STM_MIPHY
	default y if (CPU_SUBTYPE_STX7108 || CPU_SUBTYPE_FLI7510)
	default n

config STM_MIPHY_DUMMY
	bool
	depends on STM_MIPHY
	default y if (CPU_SUBTYPE_STX7100 || CPU_SUBTYPE_FLI7510)
	default n

config STPIO
	bool "Legacy stpio API"
	default n
	help
	  Select this option to enable the legacy stpio interface. No
	  code within the kernel uses this API, it is retained only for
	  drivers outside the kernel which might still need it.

config STM_DMA
	bool "STMicroelectronics DMA API"
	select SH_DMA_API
	select LIBELF
	default y
	---help---
	  Selecting this option will provide support for STMicroelectronics'
	  custom DMA API. This API provides support for data transfers of
	  various dimensions and complex linked list operations. In addition
	  to these free-running operations it also allows management of the
	  paced-transfer peripherals on recent STM parts.

	  If you have a device from STMicroelectronics, then say Y here.
	  Otherwise say N.

config STM_DMA_DEBUG
	bool "STMicroelectronics DMA Debug"
	depends on STM_DMA
	default n

config STM_COPROCESSOR_SUPPORT
	bool "STMicroelectronics coprocessor support"
	default y
	depends on (CPU_SUBTYPE_STX7100 || CPU_SUBTYPE_STX7105 \
		|| CPU_SUBTYPE_STX7111 || CPU_SUBTYPE_STX7141 \
		|| CPU_SUBTYPE_STX7200 || CPU_SUBTYPE_STX7108 \
		|| CPU_SUBTYPE_STX5206 \
		|| CPU_SUBTYPE_FLI7510)
	---help---
        Many of the ST system-on-chip devices have multiple CPUs, where a
        master CPU running Linux has control over a number of slave CPUs,
        which are usually used to run dedicated algorithms.
        Enabling this option will add support to the Linux kernel to
        control these slave CPUs, reserve memory for them, and thus allow
        code to be downloaded onto them and executed.
        Adding in the command line the following string:
        coprocessor_mem=[offset]:size0[,size1][,size2]...
        where:
        offset defines where the co-processors region starts.
               It's an offset from ST40 RAM start.
        size{n} defines the region size for the n.th slave core (max 16M).

        Example: coprocessor_mem=32m:16m,16m

config STM_NUM_COPROCESSOR
	int
	depends on STM_COPROCESSOR_SUPPORT
	default 2 if CPU_SUBTYPE_STX7100
	default 2 if CPU_SUBTYPE_STX7105
	default 2 if CPU_SUBTYPE_STX7111
	default 2 if CPU_SUBTYPE_STX7141
	default 2 if CPU_SUBTYPE_STX5206
	default 4 if CPU_SUBTYPE_STX7200
	default 3 if CPU_SUBTYPE_STX7108
	default 3 if CPU_SUBTYPE_FLI7510
	default 0

choice
	prompt "STM coprocessor loading strategy"
        depends on STM_COPROCESSOR_SUPPORT
        default STM_COPROCESSOR

config  STM_COPROCESSOR
	bool "STM coprocessor support"
	help
	  Select this option to enable support for the slave coprocessors
	  found on many ST system-on-chip devices.

config  STM_COPROCESSOR_FRMW
	bool "The new STM coprocessor firmware support "
	select FW_LOADER
	help
	  Select this option to enable support for the slave coprocessors
	  found on many ST system-on-chip devices.

endchoice

config  COPROCESSOR_DEBUG
        depends on STM_COPROCESSOR_SUPPORT
        bool "STM coprocessor debug"
        default n
        ---help---
        Enable this option to print out information about the slave CPUs
        addresses and operations you are using for coprocessor.

config STM_RNG
       bool "STM Random Number Generator Support"
       default y
       ---help---
         This option adds support for the hardware Random Number Generator
         (RNG) present on different STMicroelectronics SoCs.  It allows the
         RNG to feed /dev/random with entropy thereby ensuring real
         random numbers from this device.

         Without this option, /dev/random has little entropy and is not
         useful.  In fact, it may block for a long time while waiting for
         entropy.

         This option should always be enabled for relevant SoCs.

         This option can be used in conjunction with the /dev/hw_random
         driver found in the char drivers menu.

config STM_MALI
	depends on CPU_SUBTYPE_STX7108
	tristate "STM Mali GPU support"
	default n
	help
	  Enable this option to support Mali GPU Driver.
	  
config STM_MALI_DEBUG
	depends on STM_MALI
	bool "Enable debug tracing"
	default y
	---help---
	  Enable this option to enable debug trace messages on the console

config STM_LPC
	bool "Low power control"
	depends on PM
	default n
	---help---
	  This option adds support for the hardware Low Power Control
	  tu support the wakeup_on_timeout in the suspend operation.

config STM_LPC_DEBUG
	depends on STM_LPC
	bool "LPC debug"
	default n
	---help---
	  Enable this option to print out information about the LPC

config PMS
	bool "Power Management Scheme"
	default n
	depends on PM
	select PM_RUNTIME
	help
	  This option enables the STMicroelectronics Power Management
	  Scheme (PMS).

	  This is a kernel framework based around power profiles (pms_state),
	  where the designer can specify devices power states and the
	  clock frequency rates.
	  Moving the system between pms_states the user application can
	  tune the power consumption according with what the system is doing.

config PMS_CHECK_GROUP
	bool "PMS always checks the state group"
	depends on PMS
	default n
	help
	  Enable this option if the state group has to be controlled.
	  When a group of pms_states are enabled in the same time, this option
	  forces the PMS to check that there is no conflict inside the group
	  itself. In case of conflict the group is rejected.

config PMS_DEBUG
	bool "PMS debug"
	default n
	depends on PMS
	help
	  Enable this option to print out information about the PMS

config STM_LPM
	bool "STM Low Power Monitor"
	depends on STM_DRIVERS
	default n
	---help---
	  This option adds support for the hardware low power monitor.

config STM_LPM_RD_MONITOR
	bool "STM Low Power Monitor power key press on GPIO"
	depends on STM_LPM
	default n
	---help---
	  This enable intercept of GPIO activity by STLPM_POWER

config STM_LPM_DEBUG
	bool "STM Low Power Monitor debug"
	depends on STM_LPM
	default n
	---help---
	  Enable this option to print out information about the LPM

endmenu
```

## kernel/sound/stm/Kconfig
```kconfig
menuconfig SND_STM
	tristate "STMicroelectronics SoCs support"
	depends on SND
	depends on CPU_SUBTYPE_ST40
	select STM_DMA
	select SND_PCM
	help
		Say Y here for ALSA support on the STMicroelectronics SoCs.

		This driver provides core functionality - you have to build
		(at least one) SoC-specific driver as well. Additionally, it is
		using dynamic device minor number allocation, so udev-like
		utility is required.

		It is recommended to have BPA2 enabled with dedicated
		partition defined, however it is not absolutely necessary.

		To compile this driver as a module, choose M here: the module
	 	will be called snd-stm.ko

config SND_STM_PCM_PLAYER
	tristate
	depends on SND_STM
	default n

config SND_STM_PCM_READER
	tristate
	depends on SND_STM
	default n

config SND_STM_SPDIF_PLAYER
	tristate
	depends on SND_STM
	default n

config SND_STM_CONV_DAC_MEMORY_MAPPED
	tristate
	depends on SND_STM
	default n

config SND_STM_CONV_DAC_SYSCONF
	tristate
	depends on SND_STM
	default n

config SND_STM_CONV_I2S_TO_SPDIF
	tristate
	depends on SND_STM
	default n

config SND_STM_BPA2_PARTITION_NAME
	string "Name of BPA2 partition to allocate buffers from"
	depends on SND_STM
	depends on BPA2
	default "audio"
	help
		Define a name of BPA2 partition the driver should try to
		allocate from.

		If name is not given or given partition does not exist, driver
		will try to use "bigphysmem" partition or eventually
		preallocate some system memory using
		ALSA snd_pcm_lib_preallocate_pages_for_all() method.

		This value can be overridden by module parameter
		"bpa2_part=<name>" (or kernel command line parameter
		"snd-stm.bpa2_part=<name>", if driver is compiled into
		kernel).

comment "SOC support"
	depends on SND_STM

config SND_STM_FLI7510
	tristate "Freeman 510/520/530/540 support"
	depends on SND_STM
	default y if CPU_SUBTYPE_FLI7510
	select SND_STM_PCM_PLAYER
	select SND_STM_PCM_READER
	select SND_STM_SPDIF_PLAYER
	help
		Select this to get ALSA driver for Freeman 510/520/530/540
		(FLI7510/FLI7520/FLI7530/FLI7540) chips.

		If you compile this driver as a module, it will be
		called snd-stm-fli7510.ko

config SND_STM_STX7100
	tristate "STx7100 and STx7109 support"
	depends on SND_STM
	default y if CPU_SUBTYPE_STX7100
	select SND_STM_PCM_PLAYER
	select SND_STM_PCM_READER
	select SND_STM_SPDIF_PLAYER
	select SND_STM_CONV_DAC_MEMORY_MAPPED
	select SND_STM_CONV_I2S_TO_SPDIF
	help
		Select this to get ALSA driver for STx7100 and STx7109 chips.

		If you compile this driver as a module, it will be
		called snd-stm-stx7100.ko

config SND_STM_STX7105
	tristate "STx7105 and STx7106 support"
	depends on SND_STM
	default y if CPU_SUBTYPE_STX7105
	select SND_STM_PCM_PLAYER
	select SND_STM_PCM_READER
	select SND_STM_SPDIF_PLAYER
	select SND_STM_CONV_DAC_MEMORY_MAPPED
	select SND_STM_CONV_I2S_TO_SPDIF
	help
		Select this to get ALSA driver for STx7105 and STx7106 chips.

		If you compile this driver as a module, it will be
		called snd-stm-stx7105.ko

config SND_STM_STX7108
	tristate "STx7108 support"
	depends on SND_STM
	default y if CPU_SUBTYPE_STX7108
	select SND_STM_PCM_PLAYER
	select SND_STM_PCM_READER
	select SND_STM_SPDIF_PLAYER
	select SND_STM_CONV_DAC_SYSCONF
	select SND_STM_CONV_I2S_TO_SPDIF
	help
		Select this to get ALSA driver for STx7108 chip.

		If you compile this driver as a module, it will be
		called snd-stm-stx7108.ko

config SND_STM_STX7111
	tristate "STx7111 support"
	depends on SND_STM
	default y if CPU_SUBTYPE_STX7111
	select SND_STM_PCM_PLAYER
	select SND_STM_PCM_READER
	select SND_STM_SPDIF_PLAYER
	select SND_STM_CONV_DAC_MEMORY_MAPPED
	select SND_STM_CONV_I2S_TO_SPDIF
	help
		Select this to get ALSA driver for STx7111 chip.

		If you compile this driver as a module, it will be
		called snd-stm-stx7111.ko

config SND_STM_STX7141
	tristate "STx7141 support"
	depends on SND_STM
	default y if CPU_SUBTYPE_STX7141
	select SND_STM_PCM_PLAYER
	select SND_STM_PCM_READER
	select SND_STM_SPDIF_PLAYER
	select SND_STM_CONV_DAC_MEMORY_MAPPED
	select SND_STM_CONV_I2S_TO_SPDIF
	help
		Select this to get ALSA driver for STx7141 chip.

		If you compile this driver as a module, it will be
		called snd-stm-stx7141.ko

config SND_STM_STX7200
	tristate "STx7200 support"
	depends on SND_STM
	default y if CPU_SUBTYPE_STX7200
	select SND_STM_PCM_PLAYER
	select SND_STM_PCM_READER
	select SND_STM_SPDIF_PLAYER
	select SND_STM_CONV_DAC_MEMORY_MAPPED
	select SND_STM_CONV_I2S_TO_SPDIF
	help
		Select this to get ALSA driver for STx7200 chip.

		If you compile this driver as a module, it will be
		called snd-stm-stx7111.ko

comment "External converters"
	depends on SND_STM

config SND_STM_CONV_DUMMY
	tristate "Dummy converter driver"
	depends on SND_STM
	help
		This provides dummy converter driver to configure
		digital audio interface format (I2S, Left-Justified,
		Right-Justified). See include/sound/stm.h for
		more information.

		If compiled as module, it will be called
		snd-stm-conv-dummy.ko.

config SND_STM_CONV_EPLD
	tristate "Generic EPLD-controlled converter driver"
	depends on SND_STM
	depends on SH_ST_EPLD
	help
		This provides generic driver for EPLD-controlled
		converters. See include/sound/stm.h for informations
		how to define EPLD offsets & values.

		If compiled as module, it will be called
		snd-stm-conv-epld.ko.

config SND_STM_CONV_GPIO
	tristate "Generic GPIO-controlled converter driver"
	depends on SND_STM
	help
		This provides generic driver for GPIO-controlled
		converters. See include/sound/stm.h for informations
		how to define GPIO line numbers.

		If compiled as module, it will be called
		snd-stm-conv-gpio.ko.

config SND_STM_CONV_I2C
	tristate "Generic I2C-controlled converter driver"
	depends on SND_STM && I2C
	help
		This provides generic driver for I2C-controlled
		converters. See include/sound/stm.h for informations
		how to define required I2C addresses & commands.

		If compiled as module, it will be called
		snd-stm-conv-i2c.ko.
```
