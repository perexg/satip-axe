## kernel/arch/sh/boards/mach-adi7108/Kconfig
```kconfig
if SH_ST_ADI7108

menu "adi7108: STx7108 board options"

choice
	prompt  "adi7108 Board Version selection"
	default SH_ST_ADI7108_VER_D_BOARD
	help
	  Select the appropriate version of the board which you will be using.
	  This controls which SATA and PCIe ports will be configured.

config SH_ST_ADI7108_VER_1_0_BOARD
	bool "ADI7108 Ver 1.0 Board"
	help
	  ADI7108 Ver 1.0 Board with E-sata 0+1

config SH_ST_ADI7108_VER_B_BOARD
	bool "ADI7108 Ver B Board"
	help
	  ADI7108 Ver B Board with PCI-e Connector and E-sata 0

config SH_ST_ADI7108_VER_C_BOARD
	bool "ADI7108 Ver C Board"
	help
	  ADI7108 Ver C Board with PCI-e Connector and E-sata 0

config SH_ST_ADI7108_VER_D_BOARD
	bool "ADI7108 Ver D Board"
	help
	  ADI7108 Ver D Board without PCI-e and with sata on board

endchoice

config SH_ST_ADI7108_STMMAC0
	bool "Enable STMMAC 0"
	depends on (SH_ST_ADI7108_VER_C_BOARD || \
		    SH_ST_ADI7108_VER_B_BOARD || \
		    SH_ST_ADI7108_VER_D_BOARD)
	default n
	help
	  Enable STMMAC 0.

endmenu

endif
```

## kernel/arch/sh/boards/mach-eud7141/Kconfig
```kconfig
if SH_ST_EUD7141

menu "eud7141: STx7141 EUD reference board options"

config SH_ST_EUD7141_STMMAC0
	bool "Enable STMMAC 0"
	default n
	help
	  Enable STMMAC 0

endmenu

endif
```

## kernel/arch/sh/boards/mach-hdk7106/Kconfig
```kconfig
if SH_ST_HDK7106

menu "hdk7106: STx7106 Reference board options"

config SH_ST_HDK7106_STMMAC1
	bool "Enable STMMAC 1"
	default n
	help
	  Enable STMMAC 1

endmenu

endif
```

## kernel/arch/sh/boards/mach-hdk7108/Kconfig
```kconfig
if SH_ST_HDK7108

menu "hdk7108: STx7108 Reference board options"

config SH_ST_HDK7108_STMMAC0
	bool "Enable STMMAC 0"
	default n
	help
	  Enable STMMAC 0

config SH_ST_HDK7108_GMAC_RGMII_MODE
	bool "Use GMAC1 in RGMII mode"
	help
	  GMAC1 is the default device used on this board and it is
	  configured in GMII GTX mode.
	  This option is used to have it working in RGMII mode.
	  To support RGMII remove R29 and place it at R37.

choice
	prompt  "hdk7108 Reference Board Version selection"
	default SH_ST_HDK7108_VER2_BOARD
	help
	  Select the appropriate version of the board which you will be using.
	  This controls which SATA and PCIe ports will be configured.

config SH_ST_HDK7108_VER1_BOARD
	bool "HDK7108 Ver 1.0 Board"
	help
	  HDK7108 Ver 1.0 Board with 2 SATA's designed for CUT1.0

config SH_ST_HDK7108_VER1_1_BOARD
	bool "HDK7108 Ver 1.1 Board"
	help
	  HDK7108 Ver 1.1 Board

config SH_ST_HDK7108_VER2_BOARD
	bool "HDK7108 Ver 2.0 Board"
	help
	  HDK7108 Ver 2.0 Board with PCIe and 1 SATA's designed for CUT2.0

config SH_ST_HDK7108_VER2_1A_BOARD
	bool "HDK7108 Ver 2.1A Board"
	help
	  HDK7108 Ver 2.0 Board with 2 SATA's designed for CUT2.0

endchoice

choice
	prompt  "hdk7108 MMC slot/eMMC selection"
	default SH_ST_HDK7108_MMC_NONE if SH_ST_HDK7108_VER2_1A_BOARD
	default SH_ST_HDK7108_MMC_SLOT
	help
	  Most HDK7108 boards have a MMC card slot. However the 2.1A
	  boards are designed to take either a card slot or a soldered down
	  eMMC device depending on the population option chosen. In
	  practice it appears that most have neither! 

config	SH_ST_HDK7108_MMC_SLOT
	bool "Multi Media Card slot on board"
	help
	  Select this option if the board has an MMC card slot.

config	SH_ST_HDK7108_MMC_EMMC
	bool "Embedded Multi Media Card (eMMC) on board"
	depends on SH_ST_HDK7108_VER2_1A_BOARD
	help
	  Select this option if the board has an eMMC device.

config	SH_ST_HDK7108_MMC_NONE
	bool "No MMC card slot or eMMC device on board"
	help
	  Select this option if the board has no MMC capability.

endchoice

config STM_HDK7108_MALI_OS_MEMORY_SIZE
	hex "Maximum Mali GPU OS memory size"
	default "0x5000000"
	help
	  Specify the size of memory which the Mali driver is allowed to allocate
	  from Linux kernel.

endmenu

endif
```

## kernel/arch/sh/boards/mach-mb628/Kconfig
```kconfig
if SH_ST_MB628

menu "mb628: STx7141 Validation board options"

config SH_ST_MB628_STMMAC0
	bool "Enable STMMAC 0"
	default n
	help
	  Enable STMMAC 0

endmenu

endif
```

## kernel/arch/sh/boards/mach-mb671/Kconfig
```kconfig
if SH_ST_MB671

menu "mb671: STx200 Validation board options"

config SH_ST_MB671_STMMAC1
	bool "Enable STMMAC 1"
	default n
	help
	  Enable STMMAC 1

endmenu

endif
```

## kernel/arch/sh/boards/mach-mb837/Kconfig
```kconfig
if SH_ST_MB837

menu "mb837: STx7108 Validation board options"

config SH_ST_MB837_STMMAC0
	bool "Enable STMMAC 0"
	default n
	help
	  Enable STMMAC 0

config SH_ST_MB837_STMMAC1
	bool "Enable STMMAC 1"
	default n
	help
	  Enable STMMAC 1

endmenu

endif
```

## kernel/arch/sh/drivers/Kconfig
```kconfig
source "arch/sh/drivers/dma/Kconfig"
source "arch/sh/cchips/Kconfig"

menu "Additional SuperH Device Drivers"

config HEARTBEAT
	bool "Heartbeat LED"
	help
	  Use the power-on LED on your machine as a load meter.  The exact
	  behavior is platform-dependent, but normally the flash frequency is
	  a hyperbolic function of the 5-minute load average.

config PUSH_SWITCH
	tristate "Push switch support"
	help
	  This enables support for the push switch framework, a simple
	  framework that allows for sysfs driven switch status reporting.

config PINMUX_GPIO
	bool "Pinmuxed GPIO"
	select GENERIC_GPIO
	help
	  Select this option to use the pinmuxed GPIO driver supported on
	  some Renesas devices.

endmenu
```

## kernel/drivers/char/lirc/Kconfig
```kconfig
# LIRC http://lirc.sf.net/
# Kernel patch by Flameeyes <dgp85@users.sf.net>
# Check for new patch at http://flameeyes.web.ctonet.it
#
# Thanks to Koos Vriezen <koos.vriezen@xs4all.nl> for the Homebrew support.
# Thanks to Jeff Clark <jeff@tmtrading.com> for support when I wasn't able
# to update it and for his patch (found at http://www.clarkmania.com/~jclark/
# Thanks to Bernhard Rosenkraenzer <bero@arklinux.org> for SMP patch.
# Thanks to Vince <fuzzy77@free.fr> for the temporary lirc_atiusb driver.
# Thanks to Paul Miller <pmiller9@users.sourceforge.net> for the new working
# lirc_atiusb driver.

menu "Linux InfraRed Controller"

config LIRC_SUPPORT
	tristate "Linux InfraRed Controller"

	config LIRC_MCEUSB
		tristate "MCE USB Driver"
		depends on LIRC_SUPPORT && USB
		help
		  USB Microsoft IR Transceiver driver

	config LIRC_MCEUSB2
		tristate "MCE USB Driver"
		depends on LIRC_SUPPORT && USB
		help
		  LIRC driver for the Philips eHome USB Infrared
		  Transciever and the Microsoft MCE 2005 Remote Control

	config LIRC_SERIAL
		tristate "Serial Driver"
		depends on LIRC_SUPPORT && SERIAL_8250

		choice
			prompt "Serial Receiver Type"
			depends on LIRC_SERIAL

			config LIRC_HOMEBREW
				bool "Homebrew"

			config LIRC_SERIAL_ANIMAX
				bool "Animax"

			config LIRC_SERIAL_IRDEO
				bool "IRdeo"

			config LIRC_SERIAL_IRDEO_REMOTE
				bool "IRdeo Remote"

			config LIRC_SERIAL_NSLU2
				bool "NSLU2"

			config LIRC_SERIAL_IGOR
				bool "Igor Ceska's variation"

		endchoice

		config LIRC_SERIAL_TRANSMITTER
			bool "With transmitter diode"
			depends on LIRC_SERIAL && !LIRC_SERIAL_ANIMAX

		config LIRC_SERIAL_SOFTCARRIER
			bool "With software carrier"
			depends on LIRC_SERIAL_TRANSMITTER

		choice
			prompt "Serial Port"
			depends on LIRC_SERIAL
			config LIRC_SERIAL_COM1
				bool "COM1 (0x3f8, 4)"
			config LIRC_SERIAL_COM2
				bool "COM2 (0x2f8, 3)"
			config LIRC_SERIAL_COM3
				bool "COM3 (0x3e8, 4)"
			config LIRC_SERIAL_COM4
				bool "COM4 (0x2e8, 3)"
			config LIRC_SERIAL_OTHER
				bool "Other (custom values)"
		endchoice

		config LIRC_PORT_SERIAL
			hex "I/O Port"
				default "0x3f8" if LIRC_SERIAL_COM1
				default "0x2f8" if LIRC_SERIAL_COM2
				default "0x3e8" if LIRC_SERIAL_COM3
				default "0x2e8" if LIRC_SERIAL_COM4
			depends on LIRC_SERIAL

		config LIRC_IRQ_SERIAL
			hex "IRQ"
				default "4" if LIRC_SERIAL_COM1 || LIRC_SERIAL_COM3
				default "3" if LIRC_SERIAL_COM2 || LIRC_SERIAL_COM4
			depends on LIRC_SERIAL

	config LIRC_SIR
		tristate "SIR Driver"
		depends on LIRC_SUPPORT

		config LIRC_ON_SA1100
			bool "LIRC driver for StrongARM SA1100 embedded microprocessor"
			depends on LIRC_SIR

		choice
			prompt "SIR Type"
			depends on LIRC_SIR && !LIRC_ON_SA1100

			config LIRC_SIR_IRDA
				bool "SIR IrDA (built-in IR ports)"

			config LIRC_SIR_TEKRAM
				bool "Tekram Irmate 210 (16x50 UART compatible serial port)"

			config LIRC_SIR_ACTISYS_ACT200L
				bool "Actisys Act200L SIR driver support"

		endchoice

		choice
			prompt "Serial Port"
			depends on LIRC_SIR
			config LIRC_SIR_COM1
				bool "COM1 (0x3f8, 4)"
			config LIRC_SIR_COM2
				bool "COM2 (0x2f8, 3)"
			config LIRC_SIR_COM3
				bool "COM3 (0x3e8, 4)"
			config LIRC_SIR_COM4
				bool "COM4 (0x2e8, 3)"
			config LIRC_SIR_OTHER
				bool "Other (custom values)"
		endchoice

		config LIRC_PORT_SIR
			hex "I/O Port"
				default "0x3f8" if LIRC_SIR_COM1
				default "0x2f8" if LIRC_SIR_COM2
				default "0x3e8" if LIRC_SIR_COM3
				default "0x2e8" if LIRC_SIR_COM4
			depends on LIRC_SIR

		config LIRC_IRQ_SIR
			hex "IRQ"
				default "4" if LIRC_SIR_COM1 || LIRC_SIR_COM3
				default "3" if LIRC_SIR_COM2 || LIRC_SIR_COM4
			depends on LIRC_SIR

        config LIRC_STM
                tristate "STM Driver"
                depends on LIRC_SUPPORT && CPU_SUBTYPE_ST40
		help
		 The IR and UHF RX processors are identical and independent,
		 except that the IR receiver does not use the noise and
		 SCD filters. Not all ST platforms support both type of
		 receivers.
		 IR RX receiver is the default mode.

		config LIRC_STM_UHF
			bool "UHF RX receiver processor"
			depends on LIRC_STM
			help
			  Set this option to enable UHF instead of IR remote control input.

			  Note this option has no direct effect in the LiRC driver. It is used by
			  some boards which have support for both UHF and IR support to set the
			  configuration parameters passed into the driver. Not all boards have
			  support for both modes of operation, so this option may have no effect,
			  and hardware changes (such as changing jumpers) may be required.

	        config LIRC_STM_UHF_SCD
		        bool "Start Code Detector - SCD"
			depends on LIRC_STM_UHF
			default n
			help
			  This causes the driver to use SCD on UHF RX mode.
			  The start code detector detects any programmable start
			  code on UHF RX input. It works on a time unit called
			  symbol time. One graphical example to understand how to
			  configure properly the code, code length and nominal time
			  values based on Remote Control signals train can be found in
			  drivers/char/lirc/lirc_stm.c driver.

	        config LIRC_STM_UHF_SCD_CODE
			hex "Normal code to be detected"
			default "0x3FFFC028"
			depends on LIRC_STM_UHF_SCD
			help
			 The primary RC to be detected.
			 Default value for Futarque RC is 0x3FFFC028.

	        config LIRC_STM_UHF_SCD_ALTCODE
			hex "Alternative code to be detected"
			default "0x0"
			depends on LIRC_STM_UHF_SCD
			help
			 The second RC to be detected as alternative of the primary.
			 The primary must be always setup before the use this.

	        config LIRC_STM_UHF_SCD_NTIME
			hex "Nominal time for a symbol"
				default "0x1f4"
			depends on LIRC_STM_UHF_SCD
			help
			 Default value for Futarque RC is 0x1f4. The nominal time
			 is the same for normal and alternative symbols calculation.

		config LIRC_STM_TX
			depends on LIRC_STM
			bool "IRB TX transmitter processor"
			default n
			help
			 Say yes if you want enable IR transmission. The IR TX processor is
			 independent of IR RX mode.

	config LIRC_STM_DEBUG
		depends on LIRC_STM
		bool "Driver debug"
		default n
		help
		  Say yes if you want enable some debug printk information

	config LIRC_TTUSBIR
	        tristate "Technotrend USB IR Receiver"
	        depends on LIRC_SUPPORT && USB
	        help
	          Driver for the Technotrend USB IR Receiver

endmenu
```

## kernel/drivers/oprofile/Kconfig
```kconfig
menu Profilers

config PROFILING
	bool "Profiling support (EXPERIMENTAL)"
	help
	  Say Y here to enable the extended profiling support mechanisms used
	  by profilers such as OProfile.

config OPROFILE
	tristate "OProfile system profiling (EXPERIMENTAL)"
	depends on PROFILING
	depends on HAVE_OPROFILE
	select RING_BUFFER
	select RING_BUFFER_ALLOW_SWAP
	help
	  OProfile is a profiling system capable of profiling the
	  whole system, include the kernel, kernel modules, libraries,
	  and applications.

	  If unsure, say N.

config OP_SH_USE_TMU
	bool "Sample using TMU2 timer"
	depends on CPU_SUBTYPE_ST40 && OPROFILE
	help
	  Uses the generic timer API to sample using the TMU2 timer
	  peripheral instead of the standard timer interrupt. This 
	  allows the user to vary the sample rate with opcontrol --rate.

config OPROFILE_IBS
	bool "OProfile AMD IBS support (EXPERIMENTAL)"
	default n
	depends on OPROFILE && SMP && X86
	help
          Instruction-Based Sampling (IBS) is a new profiling
          technique that provides rich, precise program performance
          information. IBS is introduced by AMD Family10h processors
          (AMD Opteron Quad-Core processor "Barcelona") to overcome
          the limitations of conventional performance counter
          sampling.

	  If unsure, say N.

config OPROFILE_EVENT_MULTIPLEX
	bool "OProfile multiplexing support (EXPERIMENTAL)"
	default n
	depends on OPROFILE && X86
	help
	  The number of hardware counters is limited. The multiplexing
	  feature enables OProfile to gather more events than counters
	  are provided by the hardware. This is realized by switching
	  between events at an user specified time interval.

	  If unsure, say N.

config HAVE_OPROFILE
	bool

endmenu
```
